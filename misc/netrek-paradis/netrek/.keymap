# this is Ogre's (ogre@netcom.com) keymap file
#
# You should probably make you own, mine is very non-standard, I've
# included this only for reference.  You'll need to add a line
# '#include "netrek:.keymap"' to netrek:.xtrekrc in order to use
# a file like this.  Or you cna just add any lines from here to
# netrek:.xtrekrc.
#

m
#keymap: aabbccddeeffhhiikklloopprrssttuuwwxxyyzz  BBCCDDEEIILLOOMMNNPPRRSSTTUUVV??[[]]**00112233445566778899((!!@@%%##
#keymap:		qpvwsy de]aDwTd[rrRR/XX/;;iiKK`y@%%@

#buttonmap:	1t2p3k4t5p6k7t8p9k
#buttonmap: 	1*2p3k4*5p6k7*8p9ka*bpck

ckeymap.DD: 64534635
ckeymap.SC: 63554638
ckeymap.CA: 63544635
ckeymap.BB: 63544536
ckeymap.AS: 63544536
ckeymap.WB: 63524232[e
ckeymap.SB: 62524232[e
ckeymap.JS: 685^0[e
ckeymap.UT: [e


#ckeymap: Zii}c^i
# 1 - left, 2 - middle, 3 - right
# +3 = shifted
# +6 = control
# +12 = alt
cbuttonmap: 1p3k4P6^i
#
#       (q)     (w)     (e)     (r)     (t)     (y)     (u)     (i)
#   sm.update   spd. 2  torp tractor shld_up  uncloak   warp 2 info 
#       (a)     (s)     (d)     (f)     (g)        (h)     (j)
#  plan-info   cloak    det_my  pressor shld_up   orbit   repair
#       (z)     (x)     (c)       (v)      (b)     (n)     (m)    (,)   (.)   (/)
#    beamdwn(*) beamup tr/pr_off shld_dwn  bomb    plasma  message            macro
#
keymap: etr_t]v[dDf^s{y}7%[7Wwq|c$Hhzxxz64534635RrjR/X d'l,,g]wp
ckeymap: a^iw`'^u+N^x`^-
#ckeymap: g^iGi
#ckeymap: _^-

ckeymap: ^e^fu2honf

#case IS signifigant for control characters!
Dashboard.key: ^D
monobitmaps.key: ^m
#monoPlanets.key: ^p
enemyPhasers.key: ^E
sound.key: ^S
soundVolume.key: ^v
speech.volume.key: ^V
showStars.key: ^Z
speakAll.key: ^A
showIND.key: ^I
sortPlayers.key: ^K
autoPoint.key:	^W
robsort.key:	^R
useWaitTOF.key: ^w

