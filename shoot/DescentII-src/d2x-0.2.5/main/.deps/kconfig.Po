## shoot/DescentII-src/d2x-0.2.5/main/.deps/kconfig.Po
```kconfig
kconfig.o : \
 kconfig.c ../conf.h /gg/includestd/stdio.h \
 /gg/includestd/sys/types.h /gg/includestd/machine/types.h \
 /gg/includestd/sys/cdefs.h /gg/includestd/machine/cdefs.h \
 /gg/includestd/machine/ansi.h \
 /gg/lib/gcc-lib/ppc-morphos/2.95.3/include/stdarg.h \
 /gg/lib/gcc-lib/ppc-morphos/2.95.3/include/va-ppc.h \
 /gg/includestd/machine/endian.h /gg/includestd/stdlib.h \
 /gg/includestd/string.h /gg/includestd/ctype.h ../include/pa_enabl.h \
 ../include/error.h ../include/pstypes.h ../include/gr.h \
 ../include/fix.h ../include/maths.h ../include/mono.h \
 ../include/console.h ../arch/include/key.h ../include/palette.h \
 game.h /gg/includestd/setjmp.h ../include/vecmat.h object.h segment.h \
 ../include/cfile.h gameseg.h aistruct.h inferno.h piggy.h digi.h \
 sounds.h gamefont.h ../include/iff.h ../include/u_mem.h \
 ../arch/include/joy.h ../arch/include/mouse.h kconfig.h config.h \
 player.h weapon.h gamestat.h gauges.h joydefs.h songs.h render.h \
 ../include/3d.h newmenu.h endlevel.h multi.h gameseq.h mission.h \
 ../include/timer.h text.h menu.h automap.h ../include/args.h \
 lighting.h ai.h fvi.h robot.h cntrlcen.h wall.h collide.h screens.h
kconfig.c :
../conf.h :
/gg/includestd/stdio.h :
/gg/includestd/sys/types.h :
/gg/includestd/machine/types.h :
/gg/includestd/sys/cdefs.h :
/gg/includestd/machine/cdefs.h :
/gg/includestd/machine/ansi.h :
/gg/lib/gcc-lib/ppc-morphos/2.95.3/include/stdarg.h :
/gg/lib/gcc-lib/ppc-morphos/2.95.3/include/va-ppc.h :
/gg/includestd/machine/endian.h :
/gg/includestd/stdlib.h :
/gg/includestd/string.h :
/gg/includestd/ctype.h :
../include/pa_enabl.h :
../include/error.h :
../include/pstypes.h :
../include/gr.h :
../include/fix.h :
../include/maths.h :
../include/mono.h :
../include/console.h :
../arch/include/key.h :
../include/palette.h :
game.h :
/gg/includestd/setjmp.h :
../include/vecmat.h :
object.h :
segment.h :
../include/cfile.h :
gameseg.h :
aistruct.h :
inferno.h :
piggy.h :
digi.h :
sounds.h :
gamefont.h :
../include/iff.h :
../include/u_mem.h :
../arch/include/joy.h :
../arch/include/mouse.h :
kconfig.h :
config.h :
player.h :
weapon.h :
gamestat.h :
gauges.h :
joydefs.h :
songs.h :
render.h :
../include/3d.h :
newmenu.h :
endlevel.h :
multi.h :
gameseq.h :
mission.h :
../include/timer.h :
text.h :
menu.h :
automap.h :
../include/args.h :
lighting.h :
ai.h :
fvi.h :
robot.h :
cntrlcen.h :
wall.h :
collide.h :
screens.h :
```
